// SPDX-License-Identifier: BSD-3-Clause
/* Xiaomi Pad 5 (nabu) Iris plus SSC empty-provider diagnostic. */

#include "sm8150-xiaomi-nabu.dts"
#include "sm8150-xiaomi-nabu-iris.dtsi"
#include "sm8150-xiaomi-nabu-accelerometer-ssc-empty-provider.dtsi"
