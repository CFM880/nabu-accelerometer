// SPDX-License-Identifier: BSD-3-Clause
/* Xiaomi Pad 5 (nabu) SSC empty-provider diagnostic. */

#include "sm8150-xiaomi-nabu.dts"
#include "sm8150-xiaomi-nabu-accelerometer-ssc-empty-provider.dtsi"
